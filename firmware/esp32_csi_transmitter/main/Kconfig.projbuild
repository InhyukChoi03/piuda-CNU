## firmware/esp32_csi_transmitter/main/Kconfig.projbuild
```kconfig
menu "Piuda CSI transmitter configuration"

config PIUDA_TX_WIFI_SSID
    string "Wi-Fi SSID"
    default ""

config PIUDA_TX_WIFI_PASSWORD
    string "Wi-Fi password"
    default ""

config PIUDA_TX_STATION_MAC
    string "CSI transmitter station MAC"
    default "1a:50:49:55:44:41"
    help
        Locally administered unicast MAC used to identify this transmitter's
        ESP-NOW frames in the Piuda receiver. Must match the receiver setting.

config PIUDA_TX_PACKETS_PER_SECOND
    int "CSI packets per second"
    default 50
    range 10 200

endmenu
```

## firmware/esp32_csi_transmitter/sdkconfig.defaults
```kconfig
CONFIG_ESP_MAIN_TASK_STACK_SIZE=4096
CONFIG_LWIP_LOCAL_HOSTNAME="piuda-csi-tx"
CONFIG_ESPTOOLPY_FLASHSIZE_4MB=y
```

## firmware/esp32_sensor/main/Kconfig.projbuild
```kconfig
menu "Piuda sensor configuration"

config PIUDA_WIFI_SSID
    string "Wi-Fi SSID"
    default "PIUDA-CNU"

config PIUDA_WIFI_PASSWORD
    string "Wi-Fi password"
    default "piuda3017"

config PIUDA_SERVER_URL
    string "Piuda server base URL"
    default "http://192.168.4.1:8080"

config PIUDA_DEVICE_UID
    string "Registered device UID"
    default "room_2"

config PIUDA_SENSOR_KEY
    string "Sensor API key issued by caregiver dashboard"
    default "piuda-demo-3017"

config PIUDA_LOCATION
    string "Installation location"
    default "거실"

config PIUDA_PIR_GPIO
    int "PIR GPIO number"
    default 27
    range 0 48

config PIUDA_CSI_SENDER_MAC
    string "CSI transmitter station MAC"
    default "1a:50:49:55:44:41"
    help
        Must match the locally administered station MAC configured in the
        piuda_csi_transmitter project.

config PIUDA_CSI_CALIBRATION_PACKETS
    int "CSI baseline calibration packets"
    default 250
    range 50 5000

config PIUDA_CSI_MOTION_DELTA
    int "CSI motion delta threshold (percent)"
    default 20
    range 5 100

config PIUDA_CSI_MOTION_CONSECUTIVE
    int "Consecutive CSI packets required for motion"
    default 5
    range 1 100

config PIUDA_CSI_FALL_DELTA
    int "CSI fall delta threshold (percent)"
    default 55
    range 20 200

config PIUDA_CSI_FALL_CONSECUTIVE
    int "Consecutive CSI packets required for a fall candidate"
    default 3
    range 1 100

endmenu
```

## firmware/esp32_sensor/sdkconfig.defaults
```kconfig
CONFIG_ESP_MAIN_TASK_STACK_SIZE=7168
CONFIG_ESP_HTTP_CLIENT_ENABLE_HTTPS=n
CONFIG_ESP_WIFI_CSI_ENABLED=y
CONFIG_LWIP_LOCAL_HOSTNAME="piuda-sensor"
CONFIG_ESPTOOLPY_FLASHSIZE_4MB=y
```
